## firmware/components/wifi_manager/Kconfig.projbuild
```kconfig
menu "WiFi Settings"
    config WIFI_SSID
        string "WiFi SSID"
        default ""
        help
            WiFi network SSID. If NVS has no saved credentials,
            the device will auto-connect to this SSID on boot.

    config WIFI_PASSWORD
        string "WiFi Password"
        default ""
        help
            WiFi password (WPA/WPA2). Leave empty for open networks.
endmenu
```
